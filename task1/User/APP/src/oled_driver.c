#include "oled_driver.h"
#include "led_driver.h"
#include "gd32f10x.h"
#include "systick.h"

/*
@函数名称：OLED_Init
@功能说明：OLED初始化
@参数说明：无
@函数返回：无
@调用方法：OLED_Init();
@备    注：如果修改管脚 需要修改初始化的管脚 
*/ 
void OLED_Init(void)
{
  rcu_periph_clock_enable(OLED_CK_CLK); // 使能GPIOC时钟
  rcu_periph_clock_enable(OLED_DC_CLK); // 使能GPIOA时钟

  gpio_init(OLED_CK_PORT, GPIO_MODE_OUT_PP, GPIO_OSPEED_50MHZ, OLED_CK_PIN); // 初始化对应的GPIO
  gpio_bit_reset(OLED_CK_PORT, OLED_CK_PIN);

  gpio_init(OLED_DI_PORT, GPIO_MODE_OUT_PP, GPIO_OSPEED_50MHZ, OLED_DI_PIN); // 初始化对应的GPIO
  gpio_bit_reset(OLED_DI_PORT, OLED_DI_PIN);

  gpio_init(OLED_RST_PORT, GPIO_MODE_OUT_PP, GPIO_OSPEED_50MHZ, OLED_RST_PIN); // 初始化对应的GPIO
  gpio_bit_reset(OLED_RST_PORT, OLED_RST_PIN);
	
  gpio_init(OLED_DC_PORT, GPIO_MODE_OUT_PP, GPIO_OSPEED_50MHZ, OLED_DC_PIN); // 初始化对应的GPIO
  gpio_bit_reset(OLED_DC_PORT, OLED_DC_PIN);

  OLED_CK_H;
  OLED_RST_L;
  delay_1ms(50);
  OLED_RST_H;

  OLED_WrCmd(0xae); //--turn off oled panel
  OLED_WrCmd(0x00); //---set low column address
  OLED_WrCmd(0x10); //---set high column address
  OLED_WrCmd(0x40); //--set start line address  Set Mapping RAM Display Start Line (0x00~0x3F)
  OLED_WrCmd(0x81); //--set contrast control register
  OLED_WrCmd(0xcf); // Set SEG Output Current Brightness
  OLED_WrCmd(0xa1); //--Set SEG/Column Mapping     0xa0左右反置 0xa1正常
  OLED_WrCmd(0xc8); // Set COM/Row Scan Direction   0xc0上下反置 0xc8正常
  OLED_WrCmd(0xa6); //--set normal display
  OLED_WrCmd(0xa8); //--set multiplex ratio(1 to 64)
  OLED_WrCmd(0x3f); //--1/64 duty
  OLED_WrCmd(0xd3); //-set display offset	Shift Mapping RAM Counter (0x00~0x3F)
  OLED_WrCmd(0x00); //-not offset
  OLED_WrCmd(0xd5); //--set display clock divide ratio/oscillator frequency
  OLED_WrCmd(0x80); //--set divide ratio, Set Clock as 100 Frames/Sec
  OLED_WrCmd(0xd9); //--set pre-charge period
  OLED_WrCmd(0xf1); // Set Pre-Charge as 15 Clocks & Discharge as 1 Clock
  OLED_WrCmd(0xda); //--set com pins hardware configuration
  OLED_WrCmd(0x12);
  OLED_WrCmd(0xdb); //--set vcomh
  OLED_WrCmd(0x40); // Set VCOM Deselect Level
  OLED_WrCmd(0x20); //-Set Page Addressing Mode (0x00/0x01/0x02)
  OLED_WrCmd(0x02); //
  OLED_WrCmd(0x8d); //--set Charge Pump enable/disable
  OLED_WrCmd(0x14); //--set(0x10) disable
  OLED_WrCmd(0xa4); // Disable Entire Display On (0xa4/0xa5)
  OLED_WrCmd(0xa6); // Disable Inverse Display On (0xa6/a7)
  OLED_WrCmd(0xaf); //--turn on oled panel
  OLED_CLS();       // 初始清屏
  OLED_Set_Pos(0, 0);
}

/** 6*8字库  */
const unsigned char F6x8[][6] =
    {
        {0x00, 0x00, 0x00, 0x00, 0x00, 0x00}, // sp
        {0x00, 0x00, 0x00, 0x2f, 0x00, 0x00}, // !
        {0x00, 0x00, 0x07, 0x00, 0x07, 0x00}, // "
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        {0x14, 0x14, 0x14, 0x14, 0x14, 0x14}  // horiz lines
};
/* 128X64I液晶底层驱动[8X16]字体库 */
const unsigned char F8X16[] =
    {
        0x00, 0x00, 0x00, 0x00, 0x00, 0x00, 0x00, 0x00, 0x00, 0x00, 0x00, 0x00, 0x00, 0x00, 0x00, 0x00, // 0
        0x00, 0x00, 0x00, 0xF8, 0x00, 0x00, 0x00, 0x00, 0x00, 0x00, 0x00, 0x33, 0x30, 0x00, 0x00, 0x00, //! 1
        0x00, 0x10, 0x0C, 0x06, 0x10, 0x0C, 0x06, 0x00, 0x00, 0x00, 0x00, 0x00, 0x00, 0x00, 0x00, 0x00, //"2
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        0x00, 0x06, 0x01, 0x01, 0x02, 0x02, 0x04, 0x04, 0x00, 0x00, 0x00, 0x00, 0x00, 0x00, 0x00, 0x00, //~94

};
/*
* @brief    简单延时函数
*
* @param    Del_1ms ：延时时间
*
* @return   无
*
* @note     无
*
* @see      lq_oled_short_delay(1);
*/ 
void lq_oled_short_delay(unsigned int Del) //
{
  while (Del--)
  {
    __asm("NOP");
  }
}

/*!
* @brief    OLED画点命令
*
* @param    data ：要画的点
*
* @return   无
*
* @note     无
*
* @see      内部调用
*
*/
void OLED_WrDat(unsigned char data)
{
  unsigned char i = 8;
  // OLED_CS=0;;
  OLED_DC_H;
  OLED_CK_L;
  lq_oled_short_delay(1);
  while (i--)
  {
    if (data & 0x80)
    {
      OLED_DI_H;
    }
    else
    {
      OLED_DI_L;
    }
    OLED_CK_H;
    lq_oled_short_delay(1);
    // asm("nop");
    OLED_CK_L;
    data <<= 1;
  }
  // OLED_CS=1;
}
/*!
* @brief    OLED命令
*
* @param    cmd ：命令
*
* @return   无
*
* @note     无
*
* @see      内部调用
*
*/
void OLED_WrCmd(unsigned char cmd)
{
  unsigned char i = 8;

  // OLED_CS=0;;
  OLED_DC_L;
  OLED_CK_L;
  lq_oled_short_delay(1);
  while (i--)
  {
    if (cmd & 0x80)
    {
      OLED_DI_H;
    }
    else
    {
      OLED_DI_L;
    }
    OLED_CK_H;
    lq_oled_short_delay(1);
    OLED_CK_L;
    cmd <<= 1;
  }
  // OLED_CS=1;
}

/*!
* @brief    OLED设置点
*
* @param    x ：坐标   
* @param    y ：坐标
*
* @return   无
*
* @note     左上角为0,0  右下角 127,63
*
* @see      内部调用
*
*/
void OLED_Set_Pos(unsigned char x, unsigned char y)
{
  OLED_WrCmd(0xb0 + y);
  OLED_WrCmd(((x & 0xf0) >> 4) | 0x10);
  OLED_WrCmd((x & 0x0f));
}
/*!
* @brief    OLED全亮
*
* @param    无   
*
* @return   无
*
* @note     无
*
* @see      OLED_Fill(); //OLED全亮 用于检测坏点
*
*/
void OLED_Fill(void)
{
  unsigned char y, x;

  for (y = 0; y < 8; y++)
  {
    OLED_WrCmd(0xb0 + y);
    OLED_WrCmd(0x01);
    OLED_WrCmd(0x10);
    for (x = 0; x < X_WIDTH; x++)
      OLED_WrDat(0xff);
  }
}
/*!
* @brief    OLED清屏
*
* @param    无  
*
* @return   无
*
* @note     无
*
* @see      OLED_CLS(); //清屏
*
*/
void OLED_CLS(void)
{
  unsigned char y, x;
  for (y = 0; y < 8; y++)
  {
    OLED_WrCmd(0xb0 + y);
    OLED_WrCmd(0x01);
    OLED_WrCmd(0x10);
    for (x = 0; x < X_WIDTH; x++)
      OLED_WrDat(0);
  }
}
/*!
* @brief    画一个点
*
* @param    x  : 0-127 
* @param    y  : 0-63
*
* @return   无
*
* @note     OLED是按字节显示的 一个字节8位，代表8个纵向像素点，
* @note     因此如果画点 OLED_PutPixel(0,0); OLED_PutPixel(0,1); 只会显示点(0, 1) (0,0)则在画点(0,1)时清除掉
*
* @see      OLED_PutPixel(0, 0); //画一个点 左上角为0,0  右下角 127,63
*
*/
void OLED_PutPixel(unsigned char x, unsigned char y)
{
  unsigned char data1; // data1当前点的数据

  OLED_Set_Pos(x, (unsigned char)(y >> 3));
  data1 = (unsigned char)(0x01 << (y % 8));
  OLED_WrCmd((unsigned char)(0xb0 + (y >> 3)));
  OLED_WrCmd((unsigned char)(((x & 0xf0) >> 4) | 0x10));
  OLED_WrCmd((unsigned char)((x & 0x0f) | 0x00));
  OLED_WrDat(data1);
}
/*!
* @brief    清除8个点
*
* @param    x  : 0-127
* @param    y  : 0-63
*
* @return   无
*
* @note     OLED是按字节显示的 一个字节8位，代表8个纵向像素点，
*
* @see      OLED_ClrDot(0, 0); //清除(0,0)-(0,7)8个点 左上角为0,0  右下角 127,63
*
*/
void OLED_ClrDot(unsigned char x, unsigned char y)
{
  OLED_Set_Pos(x, (unsigned char)(y >> 3));
  OLED_WrCmd((unsigned char)(0xb0 + (y >> 3)));
  OLED_WrCmd((unsigned char)(((x & 0xf0) >> 4) | 0x10));
  OLED_WrCmd((unsigned char)((x & 0x0f) | 0x00));
  OLED_WrDat(0x00);
}
/*!
* @brief    画矩形
*
* @param    x1  : 0-127   左上角坐标（x1,y1）
* @param    y1  : 0-63
* @param    x2  : 0-127   右下角坐标（x2，y2）
* @param    y2  : 0-63
* @param    gif : 是否开启动画效果
*
* @return   无
*
* @note     无
*
* @see      OLED_Rectangle(0, 0, 127,62,0);   //绘制矩形
*
*/
void OLED_Rectangle(unsigned char x1, unsigned char y1, unsigned char x2, unsigned char y2, unsigned char gif)
{
  unsigned char n;
  OLED_Set_Pos(x1, y1 >> 3);
  for (n = x1; n <= x2; n++)
  {
    OLED_WrDat(0x01 << (y1 % 8));
    if (gif == 1)
      delay_1ms(10);
  }
  OLED_Set_Pos(x1, y2 >> 3);
  for (n = x1; n <= x2; n++)
  {
    OLED_WrDat(0x01 << (y2 % 8));
    if (gif == 1)
      delay_1ms(10);
  }

  for (n = y1 >> 3; n <= y2 >> 3; n++)
  {
    OLED_Set_Pos(x1, n);
    OLED_WrDat(0xff);
    if (gif == 1)
      delay_1ms(50);
  }

  for (n = y1 >> 3; n <= y2 >> 3; n++)
  {
    OLED_Set_Pos(x2, n);
    OLED_WrDat(0xff);
    if (gif == 1)
      delay_1ms(50);
  }
}
/*!
* @brief    写入一组标准ASCII字符串
*
* @param    x  : 0-127   
* @param    y  : 0-7
* @param    ch : 要显示的字符串
*
* @return   无
*
* @note     无
*
* @see      OLED_P6x8Str(0,0,"OLED 3.");  //显示字符串
*
*/
void OLED_P6x8Str(unsigned char x, unsigned char y, char ch[])
{
  unsigned char c = 0, i = 0, j = 0;
  while (ch[j] != '\0')
  {
    c = ch[j] - 32;
    if (x > 126)
    {
      x = 0;
      y++;
    }
    OLED_Set_Pos(x, y);
    for (i = 0; i < 6; i++)
      OLED_WrDat(F6x8[c][i]);
    x += 6;
    j++;
  }
}
/*!
* @brief    写入一组标准ASCII字符串
*
* @param    x  : 0-127   
* @param    y  : 0-6
* @param    ch : 要显示的字符串
*
* @return   无
*
* @note     一个字符高16  OLED高度64  
*
* @see      OLED_P8x16Str(0,0,"OLED 3.");  //显示字符串
*
*/
void OLED_P8x16Str(unsigned char x, unsigned char y, char ch[])
{
  unsigned char c = 0, i = 0, j = 0;

  while (ch[j] != '\0')
  {
    c = ch[j] - 32;
    if (x > 120)
    {
      x = 0;
      y++;
    }
    OLED_Set_Pos(x, y);
    for (i = 0; i < 8; i++)
      OLED_WrDat(F8X16[c * 16 + i]);
    OLED_Set_Pos(x, y + 1);
    for (i = 0; i < 8; i++)
      OLED_WrDat(F8X16[c * 16 + i + 8]);
    x += 8;
    j++;
  }
}

/*!
* @brief    显示BMP图片 最大 128×64
*
* @param    x0  : 0-127   左上角坐标（x0,y0）
* @param    y0  : 0-63
* @param    wide: 1-127   图片宽度
* @param    high: 1-64    图片高度
* @param    bmp : 要显示的图片
*
* @return   无
*
* @note     图片需要用软件转化
*
* @see      OLED_Show_BMP(0, 0, 104, 64, image); 
*
*/
void OLED_Show_BMP(unsigned char x0, unsigned char y0, unsigned char wide, unsigned char high, const unsigned char *bmp)
{
  unsigned int ii = 0;
  unsigned char x, y;
  unsigned char x1, y1;
  if (wide + x0 > 128 || high + y0 > 64)
  {
    return; // 超出显示范围
  }
  y1 = (y0 + high - 1) / 8;
  x1 = x0 + wide;
  for (y = y0 / 8; y <= y1; y++)
  {
    OLED_Set_Pos(x0, y);
    for (x = x0; x < x1; x++)
    {
      OLED_WrDat(bmp[ii++]);
    }
  }
}


void Test_OLED(void)
{

  OLED_Init();                   // OLED初始化
  OLED_P6x8Str(0, 7, "OLED 3."); // 字符串
  delay_1ms(2000);
  OLED_CLS();

  while (1)
  {

    led_toggle();
    OLED_P6x8Str(0, 7, "OLED 3."); // 字符串
    delay_1ms(1000);
    OLED_Rectangle(0, 0, 127, 62, 0); // 绘制矩形
    OLED_Rectangle(24, 8, 88, 55, 1);
    OLED_Rectangle(32, 16, 80, 47, 1);
    OLED_Rectangle(40, 24, 72, 39, 1);
    delay_1ms(1000);
    OLED_CLS(); // 清屏

    OLED_P8x16Str(0, 0, "OLED 4."); // 显示字符串

    OLED_PutPixel(120, 60);
    delay_1ms(1000);
    OLED_CLS(); // 清屏

    OLED_Fill(); // 填充
    delay_1ms(1000);
    OLED_CLS(); // 清屏

    // 延时
    delay_1ms(50);
  }
}
